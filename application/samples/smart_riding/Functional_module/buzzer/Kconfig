## application/samples/smart_riding/Functional_module/buzzer/Kconfig
```kconfig
#===============================================================================
# @brief    Kconfig file.
# Copyright (c) HiSilicon (Shanghai) Technologies Co., Ltd. 2024-2024. All rights reserved.
#===============================================================================
config SAMPLE_BUZZER_PIN
    int
    prompt "Choose BUZZER pin."
    depends on SAMPLE_SUPPORT_BUZZER
    default 24
    help
        GPIO pin for passive buzzer.

config SAMPLE_BUZZER_MELODY
    int
    prompt "Choose BUZZER melody (0-2)."
    depends on SAMPLE_SUPPORT_BUZZER
    default 0
    help
        Select melody: 0=Happy Birthday, 1=Mary Had a Little Lamb, 2=Simple Demo
```

## application/samples/smart_riding/Kconfig
```kconfig
#===============================================================================
# @brief    Smart riding sample kconfig file.
# Copyright (c) HiSilicon (Shanghai) Technologies Co., Ltd. 2023-2023. All rights reserved.
#===============================================================================

if ENABLE_SMART_RIDING_SAMPLE

choice SAMPLE_SUPPORT_SMART_RIDING_CHOICE
    prompt "Select Smart Riding sub-project."
    default SAMPLE_SUPPORT_SMART_RIDING_LIGHT
    help
        Select which Smart Riding sub-project to build. Only one can be selected.

config SAMPLE_SUPPORT_SMART_RIDING_LIGHT
    bool "Smart Riding Light"

config SAMPLE_SUPPORT_BUZZER
    bool "Buzzer"

config SAMPLE_SUPPORT_MPU6050
    bool "MPU6050"

config SAMPLE_SUPPORT_SMART_RIDING_TEST
    bool "Smart Riding Test"

config SAMPLE_SUPPORT_BLE_SLE_TRANSMIT
    bool "ble sle transmit"

endchoice

if SAMPLE_SUPPORT_SMART_RIDING_LIGHT
    menu "Smart Riding Light Configuration"
        osource "application/samples/smart_riding/smart_riding_light/Kconfig"
    endmenu
endif

if SAMPLE_SUPPORT_BUZZER
    menu "Buzzer Configuration"
        osource "application/samples/smart_riding/Functional_module/buzzer/Kconfig"
    endmenu
endif

if SAMPLE_SUPPORT_MPU6050
    menu "MPU6050 Configuration"
        osource "application/samples/smart_riding/Functional_module/mpu6050/Kconfig"
    endmenu
endif

if SAMPLE_SUPPORT_SMART_RIDING_TEST
    menu "Smart Riding Test Configuration"
    endmenu
endif

if SAMPLE_SUPPORT_BLE_SLE_TRANSMIT
    menu "ble_sle_transmit Configuration"
    endmenu
endif

endif
```

## application/samples/smart_riding/test/ble_test/Kconfig
```kconfig
config SAMPLE_SUPPORT_BLE_TEST
    bool "BLE GATT Server Test"
    default n
    help
      Enable BLE GATT Server test sample for smart riding.
      This implements a BLE server with UART, Battery, and Automation IO services
      that allows a phone to connect and send control commands.
```
